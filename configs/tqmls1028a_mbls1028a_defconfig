## configs/tqmls1028a_mbls1028a_defconfig
```kconfig
BR2_aarch64=y
BR2_cortex_a72=y
BR2_TOOLCHAIN_EXTERNAL=y
BR2_TOOLCHAIN_EXTERNAL_PREINSTALLED=y
BR2_TOOLCHAIN_EXTERNAL_PATH="/opt/gcc-linaro-6.2.1-2016.11-i686_aarch64-linux-gnu"
BR2_TARGET_GENERIC_HOSTNAME="OpenIL"
BR2_TARGET_GENERIC_ISSUE="Welcome to OpenIL"
BR2_ROOTFS_DEVICE_CREATION_DYNAMIC_EUDEV=y
BR2_SYSTEM_BIN_SH_BASH=y
# BR2_TARGET_GENERIC_GETTY is not set
BR2_ROOTFS_OVERLAY="board/tqc/tqmls1028a/rootfs_overlay"
BR2_ROOTFS_POST_CFG_UDEV="board/tqc/tqmls1028a/post-cfg-udev.sh"
BR2_ROOTFS_POST_IMAGE_SCRIPT="board/tqc/tqmls1028a/sd_image.sh"
BR2_ROOTFS_POST_SCRIPT_ARGS="$(LINUX_DIR) $(TOPDIR) $(UBOOT_DIR)"
BR2_LINUX_KERNEL=y
BR2_LINUX_KERNEL_CUSTOM_GIT=y
BR2_LINUX_KERNEL_CUSTOM_REPO_URL="https://github.com/tq-systems/linux-tqmaxx"
BR2_LINUX_KERNEL_CUSTOM_REPO_VERSION="TQMLS1028A-linux-v4.14.47-OpenIL-linux-201904"
BR2_LINUX_KERNEL_USE_CUSTOM_CONFIG=y
BR2_LINUX_KERNEL_CUSTOM_CONFIG_FILE="board/tqc/tqmls1028a/linux-OpenIL-linux-201904"
BR2_LINUX_KERNEL_IMAGE_TARGET_CUSTOM=y
BR2_LINUX_KERNEL_IMAGE_TARGET_NAME="Image.gz"
BR2_LINUX_KERNEL_DTS_SUPPORT=y
BR2_LINUX_KERNEL_INTREE_DTS_NAME="tqc/ls1028a-mbls1028a"
BR2_PACKAGE_BUSYBOX_CONFIG_FRAGMENT_FILES="board/nxp/common/openil-busybox.config"
BR2_PACKAGE_BUSYBOX_SHOW_OTHERS=y
BR2_PACKAGE_NETPERF=y
BR2_PACKAGE_STRACE=y
BR2_PACKAGE_STRESSAPPTEST=y
BR2_PACKAGE_E2FSPROGS=y
BR2_PACKAGE_E2FSPROGS_RESIZE2FS=y
BR2_PACKAGE_MTD=y
BR2_PACKAGE_DBUS=y
BR2_PACKAGE_I2C_TOOLS=y
BR2_PACKAGE_SYSSTAT=y
BR2_PACKAGE_LIBBLEP=y
BR2_PACKAGE_LIBNFC_NCI=y
BR2_PACKAGE_FLICKCURL=y
BR2_PACKAGE_FLICKCURL_UTILS=y
BR2_PACKAGE_CURL=y
BR2_PACKAGE_LIBCURL_VERBOSE=y
BR2_PACKAGE_LIBPCAP=y
BR2_PACKAGE_DHCPCD=y
BR2_PACKAGE_ETHTOOL=y
BR2_PACKAGE_IPUTILS=y
BR2_PACKAGE_OPENSSH=y
BR2_PACKAGE_PTP4L=y
BR2_PACKAGE_WGET=y
BR2_PACKAGE_XENOMAI=y
BR2_PACKAGE_XENOMAI_TESTSUITE=y
BR2_PACKAGE_XENOMAI_RTCAN=y
BR2_PACKAGE_XENOMAI_ANALOGY=y
BR2_PACKAGE_CGROUPFS_MOUNT=y
BR2_PACKAGE_UTIL_LINUX_LIBMOUNT=y
BR2_PACKAGE_NANO=y
BR2_PACKAGE_TSNTOOL=y
BR2_PACKAGE_RCW=y
BR2_PACKAGE_RCW_BIN="tqc/tqmls1028a/rcw_1300_sd.bin tqc/tqmls1028a/rcw_1300_emmc.bin tqc/tqmls1028a/rcw_1300_spi_nor.bin"
BR2_PACKAGE_PPA=y
BR2_PACKAGE_DP=y
BR2_PACKAGE_DP_BIN="mhdp_fw_1_0_51-dptx-hdcp-mcu2.bin"
BR2_TARGET_ROOTFS_EXT2=y
BR2_TARGET_ROOTFS_EXT2_4=y
BR2_TARGET_ROOTFS_EXT2_EXTRA_BLOCKS=102400
BR2_TARGET_ROOTFS_EXT2_EXTRA_INODES=102400
BR2_TARGET_ROOTFS_EXT2_GZIP=y
BR2_TARGET_ROOTFS_UBIFS=y
BR2_TARGET_ROOTFS_UBIFS_LEBSIZE=0xFF80
BR2_TARGET_ROOTFS_UBIFS_MINIOSIZE=0x1
BR2_TARGET_ROOTFS_UBIFS_MAXLEBCNT=4232
BR2_TARGET_ROOTFS_UBI=y
BR2_TARGET_ROOTFS_UBI_PEBSIZE=0x10000
BR2_TARGET_ROOTFS_UBI_SUBSIZE=1
BR2_TARGET_UBOOT=y
BR2_TARGET_UBOOT_BOARDNAME="tqmls1028a_mbls1028a"
BR2_TARGET_UBOOT_BOARDNAME_APPEND="sdcard emmc qspi"
BR2_TARGET_UBOOT_CUSTOM_GIT=y
BR2_TARGET_UBOOT_CUSTOM_REPO_URL="https://github.com/tq-systems/u-boot-tqmaxx.git"
BR2_TARGET_UBOOT_CUSTOM_REPO_VERSION="TQMLS1028A-u-boot-v2018.03-OpenIL-u-boot-201901"
BR2_TARGET_UBOOT_NEEDS_DTC=y
# BR2_TARGET_UBOOT_FORMAT_BIN is not set
BR2_TARGET_UBOOT_FORMAT_CUSTOM=y
BR2_TARGET_UBOOT_FORMAT_CUSTOM_NAME="u-boot-with-spl.bin"
BR2_TARGET_UBOOT_ENVIMAGE=y
BR2_TARGET_UBOOT_ENVIMAGE_SOURCE="board/nxp/ls1028ardb/u-boot-environment-64b.txt"
BR2_TARGET_UBOOT_ENVIMAGE_SIZE="0x2000"
BR2_PACKAGE_HOST_DOSFSTOOLS=y
BR2_PACKAGE_HOST_GENIMAGE=y
BR2_PACKAGE_HOST_MTOOLS=y
```

## package/rcw/Config.in
```kconfig
config BR2_PACKAGE_RCW_CUSTOM_REPO_URL
	string "URL of custom repository"

config BR2_PACKAGE_RCW_UBOOT_CUSTOM_REPO_VERSION
	string "Custom repository version"
	help
	  Revision to use in the typical format used by Git/Mercurial/Subversion
	  E.G. a sha id, a tag, branch, ..

config BR2_PACKAGE_RCW
	bool "rcw image"
	help
	The reset configuration words for NXP Layerscape platforms

if BR2_PACKAGE_RCW
config BR2_PACKAGE_RCW_BIN
	string "Custom RCW"
endif
```
